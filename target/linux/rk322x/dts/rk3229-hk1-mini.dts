/dts-v1/;

#include "rk3229.dtsi"

/ {
    model = "HK1 Mini TV Box (RK3229)";
    compatible = "hk1,mini", "rockchip,rk3229";

    memory@60000000 {
        device_type = "memory";
        reg = <0x60000000 0x40000000>; // 1GB RAM, sesuaikan jika perlu
    };

    chosen {
        bootargs = "console=ttyS2,115200n8 root=/dev/mmcblk0p2 rw";
    };

    aliases {
        serial0 = &uart2;
    };

    // Tambahkan node ethernet, usb, led, wifi, dsb sesuai hardware HK1 Mini
};